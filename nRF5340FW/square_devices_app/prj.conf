## CMakeLists.txt
```
# SPDX-License-Identifier: Apache-2.0

cmake_minimum_required(VERSION 3.20.0)
find_package(Zephyr REQUIRED HINTS $ENV{ZEPHYR_BASE})
project(secure_device_app)

FILE(GLOB app_sources app/*.c)
FILE(GLOB wrapper_sources wrapper/*.c)
target_sources(app PRIVATE
    src/main.c
    ${app_sources}
    ${wrapper_sources}
    $ENV{FWLIB_PATH}/fido2_lib/fido_ble_receive.c
    $ENV{FWLIB_PATH}/fido2_lib/fido_ble_send.c
    $ENV{FWLIB_PATH}/fido2_lib/fido_command.c
    $ENV{FWLIB_PATH}/fw_common/fw_common.c
    $ENV{FWLIB_PATH}/tiny_tft_lib/tiny_tft_const.c
    $ENV{FWLIB_PATH}/tiny_tft_lib/tiny_tft_util.c
    $ENV{FWLIB_PATH}/tiny_tft_lib/tiny_tft.c
    $ENV{FWLIB_PATH}/vendor_lib/vendor_command.c
)
target_include_directories(app PRIVATE 
    $ENV{ZEPHYR_BASE}/subsys/settings/include
    app
    $ENV{FWLIB_PATH}/fido2_lib
    $ENV{FWLIB_PATH}/fw_common
    $ENV{FWLIB_PATH}/tiny_tft_lib
    $ENV{FWLIB_PATH}/vendor_lib
    $ENV{FWLIB_PATH}/wrapper_header
)
```

## Kconfig
```
# Copyright (c) 2021 Nordic Semiconductor ASA
# SPDX-License-Identifier: Apache-2.0
#
# Application settings
#
config APP_FW_BUILD
	int "Firmware build revision serial number"
	default 100
	help
	  Serial number of application firmware build revision

config APP_SETTINGS_BUFFER_SIZE
	int "Read buffer size for app_settings"
	default 128
	depends on SETTINGS && SETTINGS_NVS
	help
	  Size of buffer for reading data from NVS

config APP_SETTINGS_THREAD_STACK_SIZE
	int "Stack size for application thread"
	default 2048
	help
	  Size of stack area used by application thread

config APP_SETTINGS_THREAD_PRIORITY
	int "Priority for application thread"
	default 7
	help
	  Number of scheduling priority used by application thread

config APP_SETTINGS_BUTTON2_LED_TEST
	bool "Use LED test with button2"
	default n
	help
	  Enables LED lighting test with second button

config APP_SETTINGS_BUTTON2_BAS_NOTIFY_TEST
	bool "Use BAS notify test with button2"
	default n
	depends on BT_BAS
	help
	  Enables BAS notify test with second button

config APP_SETTINGS_BUTTON2_ADC_MEASURE_TEST
	bool "Use ADC measurement test with button2"
	default n
	depends on ADC
	help
	  Enables ADC measurement test with second button

#
# Enable external RTCC
#
config USE_EXTERNAL_RTCC
	bool "Use external RTCC"
	default n
	depends on I2C
	help
	  Enables using of RV-3028-C7 as external RTCC

#
# Enable tiny TFT display
#
config USE_TINY_TFT
	bool "Use external tiny TFT display"
	default n
	depends on SPI
	help
	  Enables using of KWH009ST01-F01 as external TFT display

#
# Enable battery measurement
#
config USE_BATT_ADC
	bool "Use ADC for battery measurement"
	default n
	depends on ADC
	help
	  Enables using of ADC for battery measurement

source "Kconfig.zephyr"
```

## prj.conf
```kconfig
#
# for firmware revision control
#
CONFIG_APP_FW_BUILD=112

#
# for Bluetooth peripheral
#
CONFIG_BT=y
CONFIG_BT_PERIPHERAL=y
CONFIG_BT_GATT_DYNAMIC_DB=y
CONFIG_BT_LIM_ADV_TIMEOUT=90
CONFIG_BT_L2CAP_TX_MTU=126
CONFIG_BT_BUF_ACL_RX_SIZE=128
CONFIG_BT_MAX_CONN=1
CONFIG_BT_MAX_PAIRED=10
CONFIG_BT_SETTINGS=y

#
# for Bluetooth SMP
#
CONFIG_BT_SMP=y
CONFIG_BT_SMP_SC_ONLY=y
CONFIG_BT_SMP_APP_PAIRING_ACCEPT=y
CONFIG_BT_TINYCRYPT_ECC=y

#
# for Device Information Service
#
CONFIG_BT_DIS=y
CONFIG_BT_DIS_SETTINGS=y
CONFIG_BT_DIS_STR_MAX=21
CONFIG_BT_DIS_PNP=n
CONFIG_BT_DIS_MODEL="SquareDevice"
CONFIG_BT_DIS_MANUF="makmorit"
CONFIG_BT_DIS_SERIAL_NUMBER=n
CONFIG_BT_DIS_FW_REV=n
CONFIG_BT_DIS_HW_REV=n
CONFIG_BT_DIS_SW_REV=n
CONFIG_BT_DIS_SERIAL_NUMBER_STR=""
CONFIG_BT_DIS_FW_REV_STR=""
CONFIG_BT_DIS_HW_REV_STR=""
CONFIG_BT_DIS_SW_REV_STR=""

CONFIG_BT_DEVICE_NAME="SquareDevice"

#
# for Battery Service Profile
#
CONFIG_BT_BAS=y

#
# for Button and LEDs
#
CONFIG_GPIO=y

#
# for Flash ROM
#
CONFIG_FLASH=y
CONFIG_FLASH_MAP=y
CONFIG_FLASH_PAGE_LAYOUT=y
CONFIG_FLASH_LOG_LEVEL_OFF=y

# enable Non-volatile Storage in flash
CONFIG_NVS=y
CONFIG_NVS_LOG_LEVEL_OFF=y

# enable user data setting
CONFIG_SETTINGS=y
CONFIG_SETTINGS_LOG_LEVEL_OFF=y
CONFIG_PM_PARTITION_SIZE_SETTINGS_STORAGE=0x4000
CONFIG_APP_SETTINGS_BUFFER_SIZE=1024

#
# for deep sleep
#
CONFIG_POWEROFF=y

#
# for timer
#
CONFIG_COUNTER=y

#
# for debug
#
CONFIG_BT_DEBUG_LOG=n
CONFIG_BT_DEBUG_NONE=n
CONFIG_BT_DEBUG_SMP=n

#
# for system
#
CONFIG_RESET_ON_FATAL_ERROR=n
```

## overlay-opt.conf
```kconfig
#
# for USB
#
CONFIG_USB_DEVICE_STACK=y
CONFIG_USB_DEVICE_HID=y
CONFIG_USB_DEVICE_BOS=y
CONFIG_USB_DEVICE_OS_DESC=y
CONFIG_USB_DEVICE_VID=0xf055
CONFIG_USB_DEVICE_PID=0x0001
CONFIG_USB_DEVICE_MANUFACTURER="makmorit"
CONFIG_USB_DEVICE_PRODUCT="SquareDevice"
CONFIG_USB_DEVICE_SN="000000000000"
CONFIG_USB_DRIVER_LOG_LEVEL_OFF=y
CONFIG_USB_DEVICE_LOG_LEVEL_OFF=y

#
# for USB HID I/F
#
CONFIG_ENABLE_HID_INT_OUT_EP=y
CONFIG_HID_INTERRUPT_EP_MPS=64
CONFIG_USB_HID_POLL_INTERVAL_MS=10
CONFIG_USB_HID_BOOT_PROTOCOL=n
CONFIG_USB_HID_LOG_LEVEL_OFF=y

#
# for crypto
#
CONFIG_NORDIC_SECURITY_BACKEND=y
CONFIG_NRF_SECURITY_RNG=y
CONFIG_ENTROPY_GENERATOR=y

CONFIG_MBEDTLS=y
CONFIG_MBEDTLS_LIBRARY=y
CONFIG_MBEDTLS_ENABLE_HEAP=y
CONFIG_MBEDTLS_HEAP_SIZE=65536
CONFIG_MBEDTLS_INSTALL_PATH="DUMMY"
CONFIG_MBEDTLS_CTR_DRBG_C=y
CONFIG_PSA_WANT_ALG_CTR_DRBG=y

# Disable unneeded crypto operations
CONFIG_MBEDTLS_SHA384_C=n
CONFIG_MBEDTLS_SHA512_C=n
CONFIG_MBEDTLS_CIPHER_MODE_XTS=n
CONFIG_MBEDTLS_CHACHA20_C=n
CONFIG_MBEDTLS_POLY1305_C=n
CONFIG_MBEDTLS_CHACHAPOLY_C=n
CONFIG_MBEDTLS_GCM_C=n
CONFIG_MBEDTLS_PSA_CRYPTO_C=n

#
# for CBOR option
#
CONFIG_TINYCBOR=y
CONFIG_ZCBOR=n

#
# for compiler option
#
CONFIG_COMPILER_OPT="-DMBEDTLS_DES_C -DMBEDTLS_ECP_RESTARTABLE"
```

## overlay-smp.conf
```kconfig
#
# contents from smp_svr/prj.conf
#
# Enable MCUmgr and dependencies.
CONFIG_NET_BUF=y
CONFIG_ZCBOR=y
CONFIG_CRC=y
CONFIG_MCUMGR=y
CONFIG_STREAM_FLASH=y
CONFIG_FLASH_MAP=y

# Ensure an MCUboot-compatible binary is generated.
CONFIG_BOOTLOADER_MCUBOOT=y

# Enable flash operations.
CONFIG_FLASH=y

# Required by the `taskstat` command.
CONFIG_THREAD_MONITOR=y

# Support for taskstat command
CONFIG_MCUMGR_GRP_OS_TASKSTAT=y

# Enable statistics and statistic names.
CONFIG_STATS=n
CONFIG_STATS_NAMES=n

# Enable most core commands.
CONFIG_FLASH=y
CONFIG_IMG_MANAGER=y
CONFIG_MCUMGR_GRP_IMG=y
CONFIG_MCUMGR_GRP_OS=y
CONFIG_MCUMGR_GRP_STAT=n

# Enable logging
CONFIG_LOG=y
CONFIG_MCUBOOT_UTIL_LOG_LEVEL_WRN=y

#
# contents from smp_svr/overlay-bt.conf
#
# Allow for large Bluetooth data packets.
CONFIG_BT_L2CAP_TX_MTU=498
CONFIG_BT_BUF_ACL_RX_SIZE=502
CONFIG_BT_BUF_ACL_TX_SIZE=502
#CONFIG_BT_CTLR_DATA_LENGTH_MAX=251

# Enable the Bluetooth mcumgr transport (unauthenticated).
CONFIG_MCUMGR_TRANSPORT_BT=y
CONFIG_MCUMGR_TRANSPORT_BT_AUTHEN=y
CONFIG_MCUMGR_TRANSPORT_BT_CONN_PARAM_CONTROL=y

# Enable the Shell mcumgr transport.
CONFIG_BASE64=y
CONFIG_SHELL=n
CONFIG_SHELL_BACKEND_SERIAL=n
CONFIG_MCUMGR_TRANSPORT_SHELL=n

# Enable the mcumgr Packet Reassembly feature over Bluetooth and its configuration dependencies.
# MCUmgr buffer size is optimized to fit one SMP packet divided into five Bluetooth Write Commands,
# transmitted with the maximum possible MTU value: 498 bytes.
CONFIG_MCUMGR_TRANSPORT_BT_REASSEMBLY=y
CONFIG_MCUMGR_TRANSPORT_NETBUF_SIZE=2475
CONFIG_MCUMGR_GRP_OS_MCUMGR_PARAMS=y
CONFIG_MCUMGR_TRANSPORT_WORKQUEUE_STACK_SIZE=4608

# Enable the LittleFS file system.
CONFIG_FILE_SYSTEM=n
CONFIG_FILE_SYSTEM_LITTLEFS=n

# Add 256 bytes to accommodate upload command (lfs_stat overflows)
CONFIG_SYSTEM_WORKQUEUE_STACK_SIZE=2304

# Enable file system commands
CONFIG_MCUMGR_GRP_FS=n

# Enable the storage erase command.
CONFIG_MCUMGR_GRP_ZBASIC=y
CONFIG_MCUMGR_GRP_ZBASIC_STORAGE_ERASE=y

# Disable Bluetooth ping support
CONFIG_BT_CTLR_LE_PING=n

# Disable shell commands that are not needed
CONFIG_CLOCK_CONTROL_NRF_SHELL=n
CONFIG_DEVICE_SHELL=n
CONFIG_DEVMEM_SHELL=n
CONFIG_FLASH_SHELL=n
```

## boards/nrf5340dk_nrf5340_cpuapp.conf
```kconfig
#
# for Device Information Service
#
#   PCA10095_01 : nRF5340 DK with RTCC & TFT
#
CONFIG_BT_DIS_FW_REV=y
CONFIG_BT_DIS_HW_REV=y
CONFIG_BT_DIS_FW_REV_STR="0.0.4"
CONFIG_BT_DIS_HW_REV_STR="PCA10095_01"
CONFIG_BT_DEVICE_NAME="SquareDevice53"

#
# for system
#
CONFIG_HEAP_MEM_POOL_SIZE=4096

#
# for I2C external RTCC
#
CONFIG_I2C=y
CONFIG_USE_EXTERNAL_RTCC=y

#
# for SPI external TFT display
#
CONFIG_SPI=y
CONFIG_USE_TINY_TFT=y

#
# for ADC battery measurement
#
CONFIG_ADC=n
CONFIG_USE_BATT_ADC=n

#
# for function testings
#
CONFIG_APP_SETTINGS_BUTTON2_BAS_NOTIFY_TEST=n
CONFIG_APP_SETTINGS_BUTTON2_ADC_MEASURE_TEST=n
```

## boards/raytac_mdbt53v_db_40_nrf5340_cpuapp.conf
```kconfig
#
# for Device Information Service
#
#   PCA10095_02 : MDBT53V-DB with RTCC & TFT
#
CONFIG_BT_DIS_FW_REV=y
CONFIG_BT_DIS_HW_REV=y
CONFIG_BT_DIS_FW_REV_STR="0.0.4"
CONFIG_BT_DIS_HW_REV_STR="PCA10095_02"
CONFIG_BT_DEVICE_NAME="SquareDevice53"

#
# for system
#
CONFIG_HEAP_MEM_POOL_SIZE=4096

#
# for I2C external RTCC
#
CONFIG_I2C=y
CONFIG_USE_EXTERNAL_RTCC=y

#
# for SPI external TFT display
#
CONFIG_SPI=y
CONFIG_USE_TINY_TFT=y

#
# for ADC battery measurement
#
CONFIG_ADC=n
CONFIG_USE_BATT_ADC=n

#
# for board & function testings
#
CONFIG_APP_SETTINGS_BUTTON2_LED_TEST=n
CONFIG_APP_SETTINGS_BUTTON2_BAS_NOTIFY_TEST=n
CONFIG_APP_SETTINGS_BUTTON2_ADC_MEASURE_TEST=n
```

## src/main.c
```c
/* main.c - Application main entry point */

/*
 * Copyright (c) 2015-2016 Intel Corporation
 *
 * SPDX-License-Identifier: Apache-2.0
 */
#ifdef ORIGINAL_SOURCE
#include <zephyr/types.h>
#include <stddef.h>
#include <string.h>
#include <errno.h>
#include <zephyr/sys/printk.h>
#include <zephyr/sys/byteorder.h>
#include <zephyr/kernel.h>

#include <zephyr/bluetooth/bluetooth.h>
#include <zephyr/bluetooth/hci.h>
#include <zephyr/bluetooth/conn.h>
#include <zephyr/bluetooth/uuid.h>
#include <zephyr/bluetooth/gatt.h>
#include <zephyr/settings/settings.h>

#else
#include "app_process.h"
#endif

#ifdef ORIGINAL_SOURCE
static const struct bt_data ad[] = {
	BT_DATA_BYTES(BT_DATA_FLAGS, (BT_LE_AD_GENERAL | BT_LE_AD_NO_BREDR)),
	BT_DATA_BYTES(BT_DATA_UUID16_ALL, BT_UUID_16_ENCODE(BT_UUID_DIS_VAL)),
};

static void connected(struct bt_conn *conn, uint8_t err)
{
	if (err) {
		printk("Connection failed (err 0x%02x)\n", err);
	} else {
		printk("Connected\n");
	}
}

static void disconnected(struct bt_conn *conn, uint8_t reason)
{
	printk("Disconnected (reason 0x%02x)\n", reason);
}

BT_CONN_CB_DEFINE(conn_callbacks) = {
	.connected = connected,
	.disconnected = disconnected,
};

static int settings_runtime_load(void)
{
#if defined(CONFIG_BT_DIS_SETTINGS)
	settings_runtime_set("bt/dis/model",
			     "Zephyr Model",
			     sizeof("Zephyr Model"));
	settings_runtime_set("bt/dis/manuf",
			     "Zephyr Manufacturer",
			     sizeof("Zephyr Manufacturer"));
#if defined(CONFIG_BT_DIS_SERIAL_NUMBER)
	settings_runtime_set("bt/dis/serial",
			     CONFIG_BT_DIS_SERIAL_NUMBER_STR,
			     sizeof(CONFIG_BT_DIS_SERIAL_NUMBER_STR));
#endif
#if defined(CONFIG_BT_DIS_SW_REV)
	settings_runtime_set("bt/dis/sw",
			     CONFIG_BT_DIS_SW_REV_STR,
			     sizeof(CONFIG_BT_DIS_SW_REV_STR));
#endif
#if defined(CONFIG_BT_DIS_FW_REV)
	settings_runtime_set("bt/dis/fw",
			     CONFIG_BT_DIS_FW_REV_STR,
			     sizeof(CONFIG_BT_DIS_FW_REV_STR));
#endif
#if defined(CONFIG_BT_DIS_HW_REV)
	settings_runtime_set("bt/dis/hw",
			     CONFIG_BT_DIS_HW_REV_STR,
			     sizeof(CONFIG_BT_DIS_HW_REV_STR));
#endif
#endif
	return 0;
}
#endif

int main(void)
{
#ifdef ORIGINAL_SOURCE
	int err;

	err = bt_enable(NULL);
	if (err) {
		printk("Bluetooth init failed (err %d)\n", err);
		return 0;
	}

	if (IS_ENABLED(CONFIG_BT_SETTINGS)) {
		settings_load();
	}

	settings_runtime_load();

	printk("Bluetooth initialized\n");

	err = bt_le_adv_start(BT_LE_ADV_CONN_NAME, ad, ARRAY_SIZE(ad), NULL, 0);
	if (err) {
		printk("Advertising failed to start (err %d)\n", err);
		return 0;
	}

	printk("Advertising successfully started\n");
	return 0;
#else
        app_process_init();
#endif
}
```
